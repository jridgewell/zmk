## app/boards/shields/iris58/Kconfig.shield
```kconfig
# Copyright (c) 2020 Pete Johanson
# SPDX-License-Identifier: MIT

config SHIELD_IRIS58_LEFT
    def_bool $(shields_list_contains,iris58_left)

config SHIELD_IRIS58_RIGHT
    def_bool $(shields_list_contains,iris58_right)
```

## app/module/dts/bindings/sensor/ck,thb.yaml
```yaml
description: |
  Sensor driver for the C-K THB001 joystick

compatible: "ck,thb"

include: base.yaml

properties:
  io-channels:
    required: true
    description: |
      Channels available with this divider configuration.

  frequency:
    type: int
    required: false
    description: |
      The sampling frequency of the sensor. Do not set higher than 100KHz.

      If absent, a default 100Hz value will be used

  dead-zone:
    type: int
    required: false
    description: |
      Minimum delta that must be read for the sensor to trigger.

      If absent, a default 0 value will be used
```
