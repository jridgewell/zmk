/*
 * Copyright (c) 2020 The ZMK Contributors
 *
 * SPDX-License-Identifier: MIT
 */

/ {
       behaviors {
               /omit-if-no-ref/ push_inc_dec_kp: push_inc_dec_kp {
                       compatible = "zmk,behavior-sensor-push-key-press";
                       #sensor-binding-cells = <2>;
            bindings = <&kp>, <&kp>;
               };
       };
};